/**
 * @cliArgs --device "MSPM0G350X" --package "LQFP-64(PM)" --part "Default" --product "mspm0_sdk@2.01.00.03"
 * @versions {"tool":"1.19.0+3426"}
 */

/**
 * Import the modules used in this configuration.
 */
const GPIO   = scripting.addModule("/ti/driverlib/GPIO", {}, false);
const GPIO1  = GPIO.addInstance();
const SYSCTL = scripting.addModule("/ti/driverlib/SYSCTL");
const TIMER  = scripting.addModule("/ti/driverlib/TIMER", {}, false);
const TIMER1 = TIMER.addInstance();

/**
 * Write custom configuration values to the imported modules.
 */
GPIO1.$name                               = "GPIO_GRP_0";
GPIO1.associatedPins.create(2);
GPIO1.associatedPins[0].$name             = "BTN_1";
GPIO1.associatedPins[0].direction         = "INPUT";
GPIO1.associatedPins[0].assignedPort      = "PORTA";
GPIO1.associatedPins[0].assignedPin       = "18";
GPIO1.associatedPins[0].interruptEn       = true;
GPIO1.associatedPins[0].interruptPriority = "0";
GPIO1.associatedPins[0].polarity          = "RISE";
GPIO1.associatedPins[1].$name             = "BTN_2";
GPIO1.associatedPins[1].direction         = "INPUT";
GPIO1.associatedPins[1].assignedPort      = "PORTB";
GPIO1.associatedPins[1].assignedPin       = "21";
GPIO1.associatedPins[1].interruptEn       = true;
GPIO1.associatedPins[1].interruptPriority = "0";
GPIO1.associatedPins[1].polarity          = "RISE";
GPIO1.associatedPins[1].internalResistor  = "PULL_UP";
GPIO1.associatedPins[1].invert            = "ENABLE";

const Board = scripting.addModule("/ti/driverlib/Board", {}, false);

SYSCTL.forceDefaultClkConfig = true;

TIMER1.$name       = "TIMER_0";
TIMER1.timerMode   = "PERIODIC_UP";
TIMER1.interrupts  = ["ZERO"];
TIMER1.timerClkSrc = "LFCLK";
TIMER1.timerPeriod = "100 ms";

/**
 * Pinmux solution for unlocked pins/peripherals. This ensures that minor changes to the automatic solver in a future
 * version of the tool will not impact the pinmux you originally saw.  These lines can be completely deleted in order to
 * re-solve from scratch.
 */
GPIO1.associatedPins[0].pin.$suggestSolution = "PA18";
GPIO1.associatedPins[1].pin.$suggestSolution = "PB21";
Board.peripheral.$suggestSolution            = "DEBUGSS";
Board.peripheral.swclkPin.$suggestSolution   = "PA20";
Board.peripheral.swdioPin.$suggestSolution   = "PA19";
SYSCTL.peripheral.$suggestSolution           = "SYSCTL";
TIMER1.peripheral.$suggestSolution           = "TIMA0";
